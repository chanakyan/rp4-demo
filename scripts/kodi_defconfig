## scripts/kodi_defconfig
```kconfig
# SPDX-License-Identifier: BSD-2-Clause
# rp4 Kodi defconfig — minimal Linux + Kodi for Raspberry Pi 4
# Based on raspberrypi4_64_defconfig + Kodi overlay
#
# Build: make rp4_kodi_defconfig O=/output && make -j$(nproc) O=/output

# Architecture
BR2_aarch64=y
BR2_cortex_a72=y
BR2_ARM_FPU_VFPV4=y

# External toolchain (Bootlin, pre-built — fast)
BR2_TOOLCHAIN_EXTERNAL=y
BR2_TOOLCHAIN_EXTERNAL_BOOTLIN=y
BR2_TOOLCHAIN_EXTERNAL_BOOTLIN_AARCH64_GLIBC_STABLE=y

# Patches
BR2_GLOBAL_PATCH_DIR="board/raspberrypi/patches"
BR2_DOWNLOAD_FORCE_CHECK_HASHES=y

# System
BR2_TARGET_GENERIC_HOSTNAME="rp4-kodi"
BR2_TARGET_GENERIC_ISSUE="rp4 kodi"
BR2_SYSTEM_DHCP="eth0"

# Kernel — RPi Foundation fork (matches Pi 4 hardware)
BR2_LINUX_KERNEL=y
BR2_LINUX_KERNEL_CUSTOM_TARBALL=y
BR2_LINUX_KERNEL_CUSTOM_TARBALL_LOCATION="$(call github,raspberrypi,linux,21b410140c47ffab5668399f6f143c7d7b935c8b)/linux-21b410140c47ffab5668399f6f143c7d7b935c8b.tar.gz"
BR2_LINUX_KERNEL_DEFCONFIG="bcm2711"
BR2_LINUX_KERNEL_DTS_SUPPORT=y
BR2_LINUX_KERNEL_INTREE_DTS_NAME="broadcom/bcm2711-rpi-4-b"
BR2_LINUX_KERNEL_NEEDS_HOST_OPENSSL=y

# Pi 4 firmware
BR2_PACKAGE_RPI_FIRMWARE=y
BR2_PACKAGE_RPI_FIRMWARE_VARIANT_PI4=y

# Kodi
BR2_PACKAGE_KODI=y
BR2_PACKAGE_KODI_PLATFORM_GBM_GL=y

# GPU — Mesa V3D for Pi 4
BR2_PACKAGE_MESA3D=y
BR2_PACKAGE_MESA3D_GALLIUM_DRIVER_V3D=y
BR2_PACKAGE_MESA3D_GALLIUM_DRIVER_VC4=y
BR2_PACKAGE_MESA3D_OPENGL_EGL=y
BR2_PACKAGE_MESA3D_OPENGL_ES=y
BR2_PACKAGE_LIBDRM=y

# Audio
BR2_PACKAGE_ALSA_UTILS=y
BR2_PACKAGE_ALSA_LIB=y

# CEC (HDMI remote)
BR2_PACKAGE_LIBCEC=y

# Network
BR2_PACKAGE_DHCPCD=y

# Zeroconf — phone finds Kodi
BR2_PACKAGE_AVAHI=y
BR2_PACKAGE_AVAHI_DAEMON=y

# SSH for debug
BR2_PACKAGE_DROPBEAR=y

# Kernel modules
BR2_PACKAGE_KMOD=y
BR2_PACKAGE_KMOD_TOOLS=y

# Filesystem — squashfs for tryboot
BR2_TARGET_ROOTFS_SQUASHFS=y
BR2_TARGET_ROOTFS_SQUASHFS4_LZ4=y
# BR2_TARGET_ROOTFS_EXT2 is not set
# BR2_TARGET_ROOTFS_TAR is not set

# Host tools
BR2_PACKAGE_HOST_DOSFSTOOLS=y
BR2_PACKAGE_HOST_GENIMAGE=y
BR2_PACKAGE_HOST_KMOD_XZ=y
```
